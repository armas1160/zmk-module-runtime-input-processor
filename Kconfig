## Kconfig
```kconfig
config ZMK_RUNTIME_INPUT_PROCESSOR
    bool "Enable runtime input processor feature"
    select ZMK_CUSTOM_SETTINGS

if ZMK_RUNTIME_INPUT_PROCESSOR

config ZMK_RUNTIME_INPUT_PROCESSOR_INERTIA_WINDOW_SLICES
    int "Number of time slices in an inertia measurement window"
    range 4 254
    default 64

config ZMK_RUNTIME_INPUT_PROCESSOR_INERTIA_BUCKETS
    int "Inertia rolling buffer bucket count"
    range 6 256
    default 66
    help
      Must be at least the window slice count plus two. Each processor keeps
      five rolling buffers, so increasing this value uses more RAM.

config ZMK_RUNTIME_INPUT_PROCESSOR_INERTIA_REVERSE_EXIT_MIN
    int "Minimum reverse counts that stop inertia"
    range 1 65535
    default 3

config ZMK_RUNTIME_INPUT_PROCESSOR_INERTIA_REVERSE_EXIT_MAX
    int "Maximum reverse counts that stop inertia"
    range 1 65535
    default 12

config ZMK_RUNTIME_INPUT_PROCESSOR_ACCEL_WINDOW_MS
    int "Pointer acceleration speed window in milliseconds"
    range 10 500
    default 40
    help
      Pointer acceleration (accel-min-percent) estimates speed from the X/Y
      input of this window. Each processor keeps its last 32 X/Y events, so
      a long window with a fast report rate only sees the newest 32.

config ZMK_RUNTIME_INPUT_PROCESSOR_AIM_INTERVAL_MS
    int "Aim mode release interval in milliseconds"
    range 4 100
    default 15
    help
      Aim mode's smoothing holds part of the motion back. Once input pauses
      this long, the rest is sent in reports this far apart until none is
      left. Close to the Bluetooth connection interval avoids queueing.

config ZMK_RUNTIME_INPUT_PROCESSOR_GESTURE_WINDOW_MS
    int "Gesture flick window in milliseconds"
    range 50 310
    default 150
    help
      While a gesture key is held, a flick is motion that covers the gesture
      distance within this long. Rolling the ball slower than that never
      fires, so bringing the thumb back after a flick is safe.

config ZMK_RUNTIME_INPUT_PROCESSOR_GESTURE_TAP_MS
    int "How long a gesture holds its shortcut down, in milliseconds"
    range 5 200
    default 30
    help
      A gesture taps its keycode: down, this long, up. Never held, so the
      host does not repeat it.

config ZMK_RUNTIME_INPUT_PROCESSOR_STUDIO_RPC
    bool "Enable runtime input processor custom Studio RPC"
    depends on ZMK_STUDIO

config ZMK_RUNTIME_INPUT_PROCESSOR_NAME_MAX_LEN
    int "Maximum length of runtime input processor names"
    default 8

config ZMK_RUNTIME_INPUT_PROCESSOR_TEST
    bool "Enable test-only hooks for the persisted-settings boot-apply path"
    help
      Compiles in zmk_input_processor_runtime_test_apply_persisted_settings(),
      which lets a test synchronously re-run the settings boot-apply logic
      instead of waiting on the real SYS_INIT delay. Not for production use.

config ZMK_RENODE_STUDIO_UART_TRANSPORT
    bool "Studio RPC UART transport for Renode emulation testing"
    depends on ZMK_RUNTIME_INPUT_PROCESSOR_STUDIO_RPC
    select SERIAL
    select RING_BUFFER
    select UART_INTERRUPT_DRIVEN
    help
      Adds a Renode-only Studio RPC UART transport that is selected without
      a USB or BLE endpoint. This is solely for the module's hardware-free
      test build; do not enable it in firmware flashed to real hardware.

endif
```

## dts/bindings/behaviors/zmk,behavior-input-processor-aim.yaml
```yaml
# Copyright (c) 2026 The ZMK Contributors
# SPDX-License-Identifier: MIT

description: |
  Behavior for precise aiming while a key is held: the processor's cursor
  output is slowed and smoothed over its aim smoothing, so a trembling thumb
  does not shake the cursor. The temp-layer layer stays active while the key
  is held. The parameter is the speed in percent: 0 uses the processor's aim
  speed (aim-scale-percent or its runtime value), 10..100 this key's own
  (others are clamped). With several aim keys held, the newest one's speed
  applies. Usable as the hold binding of a hold-tap (&ht <speed> <key>).

compatible: "zmk,behavior-input-processor-aim"

include: one_param.yaml


properties:
  processor-name:
    type: string
    required: true
    description: Name of the runtime input processor that moves the cursor
```

## dts/bindings/behaviors/zmk,behavior-input-processor-gesture.yaml
```yaml
# Copyright (c) 2026 The ZMK Contributors
# SPDX-License-Identifier: MIT

description: |
  Behavior for trackball gestures while a key is held: the processor's motion
  moves nothing, and a flick up, down, left or right taps the keycode the
  processor assigns to that direction (gesture-left etc., runtime-settable),
  once per flick. The temp-layer layer stays active while the key is held,
  and after the release the cursor stays put until the ball stops. Usable as
  the hold binding of a hold-tap (&ht 0 <key>; pair it with
  zmk,behavior-input-processor-tap-key so a quick flick does not type the
  tap).

compatible: "zmk,behavior-input-processor-gesture"

include: zero_param.yaml

properties:
  processor-name:
    type: string
    required: true
    description: Name of the runtime input processor whose motion the gestures read
```

## dts/bindings/behaviors/zmk,behavior-input-processor-tap-key.yaml
```yaml
# Copyright (c) 2026 The ZMK Contributors
# SPDX-License-Identifier: MIT

description: |
  Key press for the tap side of a hold-tap whose hold is aim or a gesture
  (bindings = <&aim>, <&this>): like &kp, but when the hold that just ended
  used the ball (moved it, or fired a gesture) the tap is not typed. Without
  it, letting go before the tapping term after a quick aim or flick would
  also type the key.

compatible: "zmk,behavior-input-processor-tap-key"

include: one_param.yaml

properties:
  processor-name:
    type: string
    required: true
    description: Name of the runtime input processor the hold acts on
```

## dts/bindings/input_processors/zmk,input-processor-runtime.yaml
```yaml
# Copyright (c) 2026 The ZMK Contributors
# SPDX-License-Identifier: MIT

description: |
  Runtime configurable input processor for ZMK.
  Supports runtime configuration of scaling and rotation parameters.

compatible: "zmk,input-processor-runtime"

include: base.yaml

properties:
  processor-label:
    type: string
    required: true
    description: |
      Short label for the input processor (max 8 chars for BLE compatibility).
      Used to identify the processor in runtime configuration.

  type:
    type: int
    default: 0x02  # INPUT_EV_REL
    description: Event type to process

  x-codes:
    type: array
    required: true
    description: X-axis input codes to process

  y-codes:
    type: array
    required: true
    description: Y-axis input codes to process

  scale-multiplier:
    type: int
    default: 1
    description: Initial scaling multiplier

  scale-divisor:
    type: int
    default: 1
    description: Initial scaling divisor

  rotation-degrees:
    type: int
    default: 0
    description: Initial rotation angle in degrees

  tilt-degrees:
    type: int
    default: 0
    description: |
      Initial tilt compensation in degrees (0 = off). After rotation, motion
      along the tilt axis is multiplied by 1 / cos(tilt-degrees). Clamped to
      0..60 (60 doubles the axis); it never approaches 90, where the sensor
      sees no motion at all.

  tilt-axis-degrees:
    type: int
    default: 0
    description: |
      Initial axis boosted by tilt compensation, like a clock hand turned
      clockwise from the 12-6 o'clock axis: 0 = up/down, 30 = 1-7 o'clock,
      90 = left/right, -30 = 11-5 o'clock. Normalized into (-90, 90].
      Defined in the frame after rotation and before x-invert / y-invert,
      xy-swap and xy-to-scroll (the physical sensor frame); fix sensor
      mounting in the sensor driver. With a diagonal axis, drivers that
      report only the moving axis delay the cross terms until the other axis
      reports; prefer reporting both axes per motion report.

  accel-min-percent:
    type: int
    default: 100
    description: |
      Initial pointer acceleration ("precision at low speed"): gain in percent
      for input at or below accel-speed-low. Input at or above
      accel-speed-high keeps gain 1, with a smoothstep curve in between.
      Clamped to 20..100; 100 turns acceleration off (output unchanged).

  accel-speed-low:
    type: int
    default: 20
    description: |
      Speed (input counts per 100 ms, measured after rotation, tilt, axis
      inversion and axis snap, before scaling) at or below which the
      accel-min-percent gain applies.

  accel-speed-high:
    type: int
    default: 150
    description: |
      Speed (input counts per 100 ms) at or above which input is no longer
      slowed down. If it is not above accel-speed-low, the gain steps from
      accel-min-percent to 1 at accel-speed-low.

  aim-scale-percent:
    type: int
    default: 40
    description: |
      Speed in percent of the normal output while an aim behavior
      (zmk,behavior-input-processor-aim) is held. Clamped to 10..100.

  aim-smoothing-ms:
    type: int
    default: 50
    description: |
      Time constant of the low-pass filter applied while an aim behavior is
      held. The cursor trails the thumb by about this long, and back-and-forth
      faster than about 1 / (2 pi aim-smoothing-ms) is damped: at 50 ms a
      10 Hz tremor is cut to about a third. 0 turns the smoothing off.

  click-freeze-ms:
    type: int
    default: 0
    description: |
      Drop this processor's input for this long after a mouse button (&mkp)
      is pressed or released, and forget what aim mode still holds back, so
      a thumb that moves with the click does not pull the cursor off its
      target. 0 turns it off.

  track-remainders:
    type: boolean
    description: Track remainders for scaling operations (enabled if present)

  temp-layer-transparent-behavior:
    type: phandle
    description: |
      Behavior to compare against for transparent detection (typically &trans).
      Used for efficient temp-layer layer deactivation logic.

  temp-layer-kp-behavior:
    type: phandle
    description: |
      Behavior to compare against for key press detection (typically &kp).
      Used to identify modifier keys for temp-layer layer deactivation logic.

  temp-layer-keep-keycodes:
    type: array
    description: |
      List of modifier keycodes that should not deactivate the temp-layer layer.
      Typically includes LCTRL, LSHIFT, LALT, LGUI, RCTRL, RSHIFT, RALT, RGUI.

  temp-layer-enabled:
    type: boolean
    description: If present, temp-layer layer is enabled by default

  temp-layer:
    type: int
    default: 0
    description: Default target layer ID for temp-layer

  temp-layer-activation-delay-ms:
    type: int
    default: 100
    description: Default delay before activating temp-layer layer (milliseconds)

  temp-layer-deactivation-delay-ms:
    type: int
    default: 500
    description: Default delay before deactivating temp-layer layer after input stops (milliseconds)

  active-layers:
    type: int
    default: 0
    description: |
      Bitmask of layers where processor should be active (0 = all layers).
      Each bit represents a layer: bit 0 = layer 0, bit 1 = layer 1, etc.
      If at least one specified layer is active, the processor works.

  axis-snap-mode:
    type: int
    default: 0
    description: |
      Axis snapping mode: 0 = none, 1 = snap to X axis, 2 = snap to Y axis.
      When enabled, movement is locked to the selected axis unless threshold is exceeded.

  axis-snap-threshold:
    type: int
    default: 100
    description: |
      Threshold for axis snap unlock. When cross-axis movement exceeds this value
      within the timeout window, the snap lock is released.

  axis-snap-timeout-ms:
    type: int
    default: 1000
    description: |
      Time window (in milliseconds) for checking if cross-axis movement exceeds threshold.
      If threshold is not exceeded within this time, the snap lock window resets.

  xy-to-scroll-enabled:
    type: boolean
    description: If present, XY to scroll conversion is enabled

  xy-swap-enabled:
    type: boolean
    description: If present, swap X and Y axis values

  x-invert:
    type: boolean
    description: If present, invert X axis values (positive becomes negative and vice versa)

  y-invert:
    type: boolean
    description: If present, invert Y axis values (positive becomes negative and vice versa)

  inertia-enabled:
    type: boolean
    description: Enable inertia for this processor. Can also be changed in Studio.

  inertia-window-ms:
    type: int
    default: 200
    description: |
      Sliding time window used to detect rapid input and measure input totals
      after inertia starts, in milliseconds. Reports spanning multiple time
      slices are distributed proportionally across them.

  inertia-interval-ms:
    type: int
    default: 20
    description: Interval between inertia events after it starts, in milliseconds.

  inertia-threshold:
    type: int
    default: 12
    description: |
      Same-direction output amount after scaling that starts inertia inside
      one time window. Subsequent speed measurements,
      reverse movement, and generated inertia use input before scaling;
      generated output is then scaled.

  inertia-decay-percent:
    type: int
    default: 8
    description: |
      Percentage of retained inertia speed removed after each output
      interval without new physical input. Decay multiplies the remaining
      speed, producing an exponential tail. Zero holds speed and 100 stops
      output after one further interval.

  inertia-normal-max-output:
    type: int
    default: 0
    description: |
      Maximum synthetic output per interval in the normal inertia stage,
      after scaling. Zero leaves normal output unlimited. The limit does not
      apply once the fast stage starts.

  inertia-fast-threshold:
    type: int
    default: 20
    description: |
      Second-stage input amount after scaling within the inertia window.
      Zero disables fast output. Once crossed, fast output stays active until
      that inertia run ends.

  inertia-fast-output-percent:
    type: int
    default: 200
    description: |
      Percentage applied to retained target speed before subtracting physical input.
      Valid values are 100 through 1000; 200 doubles the combined output target.
```
